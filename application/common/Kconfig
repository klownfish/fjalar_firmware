## application/common/minmea/Kconfig
```kconfig
config MINMEA_LOG_LEVEL
    int "minmea log level"
    default 2
    depends on LOG
```

## application/common/protocol/Kconfig
```kconfig
config PROTOCOL_LOG_LEVEL
    int "protocol filter log level"
    default 2
    depends on LOG
```

## application/flight_controller/boards/arm/fjalar/Kconfig.board
```kconfig
# STM32U575ZI Q Nucleo board configuration

# Copyright (c) 2021 Linaro Limited
# SPDX-License-Identifier: Apache-2.0

config BOARD_FJALAR
	bool "Fjalar flight controller"
	depends on SOC_STM32U575XX
```

## application/flight_controller/boards/arm/fjalar/fjalar_defconfig
```kconfig
CONFIG_SOC_SERIES_STM32U5X=y
CONFIG_SOC_STM32U575XX=y

# Enable clock
CONFIG_CLOCK_CONTROL=y

# Enable MPU
CONFIG_ARM_MPU=y

# Enable HW stack protection
CONFIG_HW_STACK_PROTECTION=y

# enable pin controller
CONFIG_PINCTRL=y

CONFIG_GPIO=y
```

## application/flight_controller/boards/vendor/fjalar/Kconfig.fjalar
```kconfig
# Copyright (c) 2021 Linaro Limited
# SPDX-License-Identifier: Apache-2.0

config BOARD_FJALAR
	select SOC_STM32U575XX
```

## application/flight_controller/boards/vendor/fjalar/board.yml
```yaml
board:
  name: fjalar
  full_name: Fjalar Flightcontroller
  vendor: vendor
  socs:
    - name: stm32u575xx
```

## application/flight_controller/boards/vendor/fjalar/fjalar_defconfig
```kconfig
# Enable MPU
CONFIG_ARM_MPU=y

# Enable HW stack protection
CONFIG_HW_STACK_PROTECTION=y

# enable pin controller
CONFIG_PINCTRL=y

CONFIG_GPIO=y
```

## application/flight_controller/modules/dummysensor/drivers/sensor/Kconfig
```kconfig
# Copyright (c) 2021 Nordic Semiconductor ASA
# SPDX-License-Identifier: Apache-2.0

if SENSOR
rsource "dummysensor/Kconfig"
endif # SENSOR
```

## application/flight_controller/modules/dummysensor/drivers/sensor/dummysensor/Kconfig
```kconfig
config DUMMYSENSOR
	bool "dummy sensor"
	default n
	depends on DT_HAS_AESIR_DUMMYSENSOR_ENABLED


choice
	prompt "select data source for the dummy sensor"
	config DUMMYSENSOR_SKYWARD
		bool "skyward data"
	config DUMMYSENSOR_PICCARD
		bool "piccard data"
	config DUMMYSENSOR_ICLR
		bool "iclr data"
endchoice
```

## application/flight_controller/modules/dummysensor/dts/bindings/sensor/aesir,dummysensor.yaml
```yaml
description: |
  A dummy barometer and IMU

compatible: "aesir,dummysensor"

include: base.yaml
```

## application/tracker/boards/arm/t_echo/Kconfig.defconfig
```kconfig
# nRF52840-MDK board configuration

# Copyright (c) 2018 makerdiary.com
# SPDX-License-Identifier: Apache-2.0

if BOARD_T_ECHO

config BOARD
	default "T-Echo"

config BT_CTLR
	default BT

endif # BOARD_NRF52840_MDK
```

## application/west.yml
```yaml
manifest:

  defaults:
    remote: zephyrproject

  remotes:
    - name: zephyrproject
      url-base: https://github.com/zephyrproject-rtos


  projects:
    - name: zephyr
      remote: zephyrproject
      revision: v3.4.0
      import:
        path-prefix: deps

    - name: zscilib
      remote: zephyrproject
      revision: 34c3432e81085bb717e4871d21ca419ae0058ec5
      path: deps/modules/lib/zscilib

    - name: lvgl
      remote: zephyrproject
      revision: 9fe0a7cc0fb94bcbefc036ee27f1842f13e4e624
      path: deps/modules/lib/gui/lvgl

  self:
    path: application
```
